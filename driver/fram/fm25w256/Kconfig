## driver/fram/fm25w256/Kconfig
```kconfig
menuconfig USE_SPI_FM25W256
    bool "FRAM FM25W256"
    default y

    if USE_SPI_FM25W256
        choice
            prompt "SPI BUS"
            config SPI_FM25W256_MCBSPA
                depends on ENABLE_MCBSPA_SPI
                bool "McBSP-A"
            config SPI_FM25W256_MCBSPB
                depends on ENABLE_MCBSPB_SPI
                bool "McBSP-B"
        endchoice

        config SPI_FM25W256_CS
            int "Chip Select GPIO"
            default 15

        config SPI_FM25W256_SIZE
            int
            default 32768

        config SPI_FM25W256_DEFAULT_TIMEOUT
            int "Default Pending Timeout"
            default 100

    menu "FM25W256 Commands (test)"
        depends on USE_CLI
        config ENABLE_CLI_FM25W256_COMMAND
            bool "Enable Test Command"
            default n
        config ENABLE_CLI_FM25W256_CMD_WRITE
            depends on ENABLE_CLI_FM25W256_COMMAND
            bool "FM25W256_write"
            default y
        config ENABLE_CLI_FM25W256_CMD_READ
            depends on ENABLE_CLI_FM25W256_COMMAND
            bool "FM25W256_read"
            default y
    endmenu

    endif
```

## driver/spi/Kconfig
```kconfig
menuconfig USE_SPI_DEVICE
    bool "SPI"
    default y

    if USE_SPI_DEVICE
        menuconfig ENABLE_MCBSPA_SPI
            bool "McBSP-A"
            default y

            if ENABLE_MCBSPA_SPI
                menu "IO Configuration"
                    config MCBSPA_SPI_MDX_PULLUP_ENABLE
                        bool "Enable MOSI pull-up"
                        default n
                    config MCBSPA_SPI_MDR_PULLUP_ENABLE
                        bool "Enable MISO pull-up"
                        default n
                    config MCBSPA_SPI_MCLX_PULLUP_ENABLE
                        bool "Enable CLK pull-up"
                        default n
                endmenu #"IO Configuration"
                config TASK_PRIO_MCBSPA_SPI
                    int "Task Priority"
                    default 1
                config TASK_STACK_MCBSPA_SPI
                    int "Task Stack"
                    default 512
                config MCBSPA_SPI_MAX_REQUEST_COUNT
                    int "Max number of SPI transaction Request"
                    default 10
                config MCBSPA_SPI_DEFAULT_TIMEOUT
                    int "Default pending timeout"
                    default 100
            endif

        menuconfig ENABLE_MCBSPB_SPI
            bool "McBSP-B"
            default y

            if ENABLE_MCBSPB_SPI
                menu "IO Configuration"
                    choice
                        prompt "MOSI GPIO"
                        default MCBSPB_SPI_MDX_GPIO12
                        config MCBSPB_SPI_MDX_GPIO12
                                bool "GPIO12"
                        config MCBSPB_SPI_MDX_GPIO24
                            bool "GPIO24"
                    endchoice
                    config MCBSPB_SPI_MDX_GPIO
                        int
                        default 12 if MCBSPB_SPI_MDX_GPIO12
                        default 24 if MCBSPB_SPI_MDX_GPIO24
                    config MCBSPB_SPI_MDX_PULLUP_ENABLE
                        bool "Enable MOSI pull-up"
                        default n
                    choice
                        prompt "MISO GPIO"
                        default MCBSPB_SPI_MDR_GPIO13
                        config MCBSPB_SPI_MDR_GPIO13
                            bool "GPIO13"
                        config MCBSPB_SPI_MDR_GPIO25
                            bool "GPIO25"
                    endchoice
                    config MCBSPB_SPI_MDR_GPIO
                        int
                        default 13 if MCBSPB_SPI_MDR_GPIO13
                        default 25 if MCBSPB_SPI_MDR_GPIO25
                    config MCBSPB_SPI_MDR_PULLUP_ENABLE
                        bool "Enable MISO pull-up"
                        default n

                    choice
                        prompt "CLK GPIO"
                        default MCBSPB_SPI_CLK_GPIO14
                        config MCBSPB_SPI_CLK_GPIO14
                            bool "GPIO14"
                        config MCBSPB_SPI_CLK_GPIO26
                            bool "GPIO26"
                    endchoice
                    config MCBSPB_SPI_MCLKX_GPIO
                        int
                        default 14 if MCBSPB_SPI_CLK_GPIO14
                        default 26 if MCBSPB_SPI_CLK_GPIO26
                    config MCBSPB_SPI_MCLX_PULLUP_ENABLE
                        bool "Enable CLK pull-up"
                        default n
                endmenu #"IO configuration"

                config TASK_PRIO_MCBSPB_SPI
                    int "Task Priority"
                    default 1
                config TASK_STACK_MCBSPB_SPI
                    int "Task Stack"
                    default 512

                config MCBSPB_SPI_MAX_REQUEST_COUNT
                    int "Max number of SPI transaction Request"
                    default 10
                config MCBSPB_SPI_DEFAULT_TIMEOUT
                    int "Default pending timeout"
                    default 100
            endif

        menuconfig ENABLE_FIFO_SPI
            bool "SPI-FIFO"
            default n

            if ENABLE_FIFO_SPI
                menu "IO Configuration"
                    choice
                        prompt "MOSI GPIO"
                        default FIFO_SPI_MOSI_GPIO54
                        config FIFO_SPI_MOSI_GPIO16
                            bool "GPIO16"
                        config FIFO_SPI_MOSI_GPIO54
                            bool "GPIO54"
                    endchoice

                    config FIFO_SPI_MOSI_PULLUP_ENABLE
                        bool "Enable MOSI internal pull-up"
                        default y

                    choice
                        prompt "MISO GPIO"
                        default FIFO_SPI_MISO_GPIO55
                        config FIFO_SPI_MISO_GPIO17
                            bool "GPIO17"
                        config FIFO_SPI_MISO_GPIO55
                            bool "GPIO55"
                    endchoice

                    config FIFO_SPI_MISO_PULLUP_ENABLE
                        bool "Enable MISO internal pull-up"
                        default y

                    choice
                        prompt "CLOCK GPIO"
                        default FIFO_SPI_CLK_GPIO56
                        config FIFO_SPI_CLK_GPIO18
                            bool "GPIO18"
                        config FIFO_SPI_CLK_GPIO56
                            bool "GPIO56"
                    endchoice

                    config FIFO_SPI_CLOCK_PULLUP_ENABLE
                        bool "Enable Clock internal pull-up"
                        default y

                endmenu # "IO Configuration"

                config FIFO_SPI_BAUDRATE_KHZ
                    int "Baud Rate (Unit: kHz)"
                    default 500
                config TASK_PRIO_FIFO_SPI
                    int "Task Priority"
                    default 1
                config TASK_STACK_FIFO_SPI
                    int "Task Stack"
                    default 512
                config FIFO_SPI_MAX_REQUEST_COUNT
                    int "Max number of SPI transaction Request"
                    default 10
                config FIFO_SPI_DEFAULT_TIMEOUT
                    int "Default pending timeout"
                    default 100
            endif # ENABLE_FIFO_SPI

        config SPI_RUN_IN_RAM
            bool "Run SPI functions in RAM"
            default n

        menu "SPI Commands (test)"
            depends on USE_CLI

            config ENABLE_CLI_SPI_COMMAND
                bool "Enable Test Command"
                default n
            config ENABLE_CLI_SPI_CMD_LIST
                depends on ENABLE_CLI_SPI_COMMAND
                bool "spi_list"
                default n
            config ENABLE_CLI_SPI_CMD_TRANSACT
                depends on ENABLE_CLI_SPI_COMMAND
                bool "spi_transact"
                default n
            config CLI_SPI_MCBSPA_CS_GPIO
                depends on ENABLE_CLI_SPI_COMMAND && ENABLE_CLI_SPI_CMD_TRANSACT && ENABLE_MCBSPA_SPI
                int "SPI McBSP-A Test CS GPIO"
                default 23
            config CLI_SPI_MCBSPB_CS_GPIO
                depends on ENABLE_CLI_SPI_COMMAND && ENABLE_CLI_SPI_CMD_TRANSACT && ENABLE_MCBSPB_SPI
                int "SPI McBSP-B Test CS GPIO"
                default 23
            config CLI_SPI_FIFO_CS_GPIO
                depends on ENABLE_CLI_SPI_COMMAND && ENABLE_CLI_SPI_CMD_TRANSACT && ENABLE_FIFO_SPI
                int "SPI FIFO Test CS GPIO"
                default 19
        endmenu

    rsource "../fram/fm25w256/Kconfig"

    endif
```

## driver/uart/Kconfig
```kconfig
menuconfig USE_UART
    bool "UART"
    default y

    if USE_UART
        menuconfig ENABLE_UARTA
            bool "Enable UARTA"
            default y

            if ENABLE_UARTA
                choice
                    prompt "TX GPIO"
                    default UARTA_TX_GPIO29
                    config UARTA_TX_GPIO29
                        bool "GPIO29"
                    config UARTA_TX_GPIO35
                        bool "GPIO35"
                endchoice
                config UARTA_TX_GPIO
                    int
                    default 29 if UARTA_TX_GPIO29
                    default 35 if UARTA_TX_GPIO35

                choice
                    prompt "RX GPIO"
                    default UARTA_RX_GPIO28
                    config UARTA_RX_GPIO28
                        bool "GPIO28"
                    config UARTA_RX_GPIO36
                        bool "GPIO36"
                endchoice
                config UARTA_RX_GPIO
                    int
                    default 28 if UARTA_RX_GPIO28
                    default 36 if UARTA_RX_GPIO36

                config BAUDRATE_UARTA
                    int "Baud Rate"
                    default 115200
                config TX_QUEUE_BUFF_SZ_UARTA
                    int "Transmit Queue Buffer Size"
                    default 256
                config RX_QUEUE_BUFF_SZ_UARTA
                    int "Receive Queue Buffer Size"
                    default 128
            endif

        menuconfig ENABLE_UARTB
            bool "Enable UARTB"
            default n

            if ENABLE_UARTB
                choice
                    prompt "TX GPIO"
                    default UARTB_TX_GPIO18
                    config UARTB_TX_GPIO9
                        bool "GPIO9"
                    config UARTB_TX_GPIO14
                        bool "GPIO14"
                    config UARTB_TX_GPIO18
                        bool "GPIO18"
                    config UARTB_TX_GPIO22
                        bool "GPIO22"
                endchoice
                config UARTB_TX_GPIO
                    int
                    default 9 if UARTB_TX_GPIO9
                    default 14 if UARTB_TX_GPIO14
                    default 18 if UARTB_TX_GPIO18
                    default 22 if UARTB_TX_GPIO22

                choice
                    prompt "RX GPIO"
                    default UARTB_RX_GPIO19
                    config UARTB_RX_GPIO11
                        bool "GPIO11"
                    config UARTB_RX_GPIO15
                        bool "GPIO15"
                    config UARTB_RX_GPIO19
                        bool "GPIO19"
                    config UARTB_RX_GPIO23
                        bool "GPIO23"
                endchoice
                config UARTB_RX_GPIO
                    int
                    default 11 if UARTB_RX_GPIO11
                    default 15 if UARTB_RX_GPIO15
                    default 19 if UARTB_RX_GPIO19
                    default 23 if UARTB_RX_GPIO23

                config BAUDRATE_UARTB
                    int "Baud Rate"
                    default 115200
                config TX_QUEUE_BUFF_SZ_UARTB
                    int "Transmit Queue Buffer Size"
                    default 256
                config RX_QUEUE_BUFF_SZ_UARTB
                    int "Receive Queue Buffer Size"
                    default 128
            endif

        menuconfig ENABLE_UARTC
            bool "Enable UARTC"
            default n

            if ENABLE_UARTC
                config UARTC_TX_GPIO
                    int
                    default 63
                config UARTC_RX_GPIO
                    int
                    default 62
                config BAUDRATE_UARTC
                    int "Baud Rate"
                    default 115200
                config TX_QUEUE_BUFF_SZ_UARTC
                    int "Transmit Queue Buffer Size"
                    default 256
                config RX_QUEUE_BUFF_SZ_UARTC
                    int "Receive Queue Buffer Size"
                    default 128
            endif
    endif

menuconfig USE_CLI
    bool "CLI"
    default y

    if USE_CLI
        config CLI_TASK_PRIORITY
            int "Task Priority"
            default 1
        config CLI_TASK_STACK
            int "Task Stack"
            default 526

        config CLI_ECHO_INPUT
            bool "Echo Input String"
            default n

        choice
            prompt "Input/Output Stream"
            config CLI_IO_UART
                bool "UART"
        endchoice

        choice
            depends on CLI_IO_UART
            prompt "UART Channel"
            config CLI_IO_UART_A
                depends on ENABLE_UARTA
                bool "UART-A"
            config CLI_IO_UART_B
                depends on ENABLE_UARTB
                bool "UART-B"
            config CLI_IO_UART_C
                depends on ENABLE_UARTC
                bool "UART-C"
        endchoice

        config CLI_COMMAND_MAX_OUTPUT_SIZE
            int "Buffer size for CLI output"
            default 256

        config CLI_COMMAND_MAX_INPUT_SIZE
            int "Buffer size for CLI input"
            default 256

    endif # USE_CLI
```

## example/Kconfig
```kconfig
mainmenu "LittleFS_C2000"

config SYSTEM_FREQ_MHZ
    int
    default 150

rsource "../driver/uart/Kconfig"
rsource "../driver/spi/Kconfig"
rsource "../filesystem/Kconfig"
```
