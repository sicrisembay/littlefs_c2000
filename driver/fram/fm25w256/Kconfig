## example/configs/lfs_defconfig
```kconfig
CONFIG_SYSTEM_FREQ_MHZ=150
CONFIG_USE_UART=y
CONFIG_ENABLE_UARTA=y
CONFIG_UARTA_TX_GPIO29=y
# CONFIG_UARTA_TX_GPIO35 is not set
CONFIG_UARTA_TX_GPIO=29
CONFIG_UARTA_RX_GPIO28=y
# CONFIG_UARTA_RX_GPIO36 is not set
CONFIG_UARTA_RX_GPIO=28
CONFIG_BAUDRATE_UARTA=115200
CONFIG_TX_QUEUE_BUFF_SZ_UARTA=256
CONFIG_RX_QUEUE_BUFF_SZ_UARTA=128
# CONFIG_ENABLE_UARTB is not set
# CONFIG_ENABLE_UARTC is not set
CONFIG_USE_CLI=y
CONFIG_CLI_TASK_PRIORITY=1
CONFIG_CLI_TASK_STACK=4096
# CONFIG_CLI_ECHO_INPUT is not set
CONFIG_CLI_IO_UART=y
CONFIG_CLI_IO_UART_A=y
CONFIG_CLI_COMMAND_MAX_OUTPUT_SIZE=256
CONFIG_CLI_COMMAND_MAX_INPUT_SIZE=256
CONFIG_USE_SPI_DEVICE=y
# CONFIG_ENABLE_MCBSPA_SPI is not set
CONFIG_ENABLE_MCBSPB_SPI=y

#
# IO Configuration
#
CONFIG_MCBSPB_SPI_MDX_GPIO12=y
# CONFIG_MCBSPB_SPI_MDX_GPIO24 is not set
CONFIG_MCBSPB_SPI_MDX_GPIO=12
# CONFIG_MCBSPB_SPI_MDX_PULLUP_ENABLE is not set
CONFIG_MCBSPB_SPI_MDR_GPIO13=y
# CONFIG_MCBSPB_SPI_MDR_GPIO25 is not set
CONFIG_MCBSPB_SPI_MDR_GPIO=13
# CONFIG_MCBSPB_SPI_MDR_PULLUP_ENABLE is not set
CONFIG_MCBSPB_SPI_CLK_GPIO14=y
# CONFIG_MCBSPB_SPI_CLK_GPIO26 is not set
CONFIG_MCBSPB_SPI_MCLKX_GPIO=14
# CONFIG_MCBSPB_SPI_MCLX_PULLUP_ENABLE is not set
# end of IO Configuration

CONFIG_TASK_PRIO_MCBSPB_SPI=1
CONFIG_TASK_STACK_MCBSPB_SPI=512
CONFIG_MCBSPB_SPI_MAX_REQUEST_COUNT=10
CONFIG_MCBSPB_SPI_DEFAULT_TIMEOUT=100
# CONFIG_ENABLE_FIFO_SPI is not set
CONFIG_SPI_RUN_IN_RAM=y

#
# SPI Commands (test)
#
# CONFIG_ENABLE_CLI_SPI_COMMAND is not set
# end of SPI Commands (test)

CONFIG_USE_SPI_FM25W256=y
CONFIG_SPI_FM25W256_MCBSPB=y
CONFIG_SPI_FM25W256_CS=15
CONFIG_SPI_FM25W256_SIZE=32768
CONFIG_SPI_FM25W256_DEFAULT_TIMEOUT=100

#
# FM25W256 Commands (test)
#
# CONFIG_ENABLE_CLI_FM25W256_COMMAND is not set
# end of FM25W256 Commands (test)

CONFIG_USE_FILESYSTEM=y
CONFIG_USE_LITTLEFS=y
CONFIG_LFS_READ_SZ=1
CONFIG_LFS_PROG_SZ=1
CONFIG_LFS_BLOCK_SZ=128
CONFIG_ENABLE_CLI_LFS_COMMAND=y
CONFIG_ENABLE_CLI_LFS_CMD_FORMAT=y
CONFIG_ENABLE_CLI_LFS_CMD_MOUNT=y
CONFIG_ENABLE_CLI_LFS_CMD_LS=y
CONFIG_ENABLE_CLI_LFS_CMD_MKDIR=y
CONFIG_ENABLE_CLI_LFS_CMD_FOPEN=y
CONFIG_USE_YMODEM=y
CONFIG_YMODEM_UART_A=y
CONFIG_ENABLE_CLI_YMODEM_COMMAND=y
CONFIG_ENABLE_CLI_YMODEM_CMD_RECEIVE=y
CONFIG_ENABLE_CLI_YMODEM_CMD_SEND=y
```

## filesystem/Kconfig
```kconfig
menuconfig USE_FILESYSTEM
    bool "Filesystem"
    default y

    if USE_FILESYSTEM
        menuconfig USE_LITTLEFS
            bool "LittleFS"
            default y

            if USE_LITTLEFS
                config LFS_READ_SZ
                    int "Minimum Block Read Size"
                    default 1
                config LFS_PROG_SZ
                    int "Minimum Block Program Size"
                    default 1
                config LFS_BLOCK_SZ
                    int "Eraseable Block Size"
                    default 128

                menuconfig ENABLE_CLI_LFS_COMMAND
                    depends on USE_CLI
                    bool "Test Command"
                    default y

                    if ENABLE_CLI_LFS_COMMAND
                        config ENABLE_CLI_LFS_CMD_FORMAT
                            bool "lfs_format"
                            default y
                        config ENABLE_CLI_LFS_CMD_MOUNT
                            bool "lfs_mount"
                            default y
                        config ENABLE_CLI_LFS_CMD_LS
                            bool "lfs_ls"
                            default y
                        config ENABLE_CLI_LFS_CMD_MKDIR
                            bool "lfs_mkdir"
                            default y
                        config ENABLE_CLI_LFS_CMD_FOPEN
                            bool "lfs_fopen"
                            default y
                    endif # ENABLE_CLI_LFS_COMMAND
            endif # USE_LITTLEFS

    rsource "ymodem/Kconfig"


    endif # USE_FILESYSTEM
```

## filesystem/ymodem/Kconfig
```kconfig
menuconfig USE_YMODEM
    depends on USE_FILESYSTEM
    bool "YMODEM"
    default y

    if USE_YMODEM
        choice
            depends on USE_UART
            prompt "Channel"
            config YMODEM_UART_A
                depends on ENABLE_UARTA
                bool "UART-A"
            config YMODEM_UART_B
                depends on ENABLE_UARTB
                bool "UART-B"
            config YMODEM_UART_C
                depends on ENABLE_UARTC
                bool "UART-C"
        endchoice

        menuconfig ENABLE_CLI_YMODEM_COMMAND
            depends on USE_CLI
            bool "Test Command"
            default y

            if ENABLE_CLI_YMODEM_COMMAND
                config ENABLE_CLI_YMODEM_CMD_RECEIVE
                    bool "ymodem_receive"
                    default y
                config ENABLE_CLI_YMODEM_CMD_SEND
                    bool "ymodem_send"
                    default y
            endif
    endif
```
